## projects/18_govee_monitor/sdkconfig.defaults
```kconfig
CONFIG_IDF_TARGET="esp32c6"
CONFIG_ESPTOOLPY_FLASHSIZE_16MB=y
CONFIG_PARTITION_TABLE_CUSTOM=y
CONFIG_PARTITION_TABLE_CUSTOM_FILENAME="partitions.csv"
CONFIG_COMPILER_OPTIMIZATION_PERF=y

# USB Serial JTAG console (UART0 not wired to USB-C on this board)
CONFIG_ESP_CONSOLE_USB_SERIAL_JTAG=y

# LVGL
CONFIG_LV_FONT_MONTSERRAT_14=y
CONFIG_LV_FONT_MONTSERRAT_16=y
CONFIG_LV_FONT_MONTSERRAT_28=y
CONFIG_LV_FONT_MONTSERRAT_48=y
CONFIG_LV_MEM_SIZE_KILOBYTES=48
CONFIG_LV_COLOR_16_SWAP=y

# FreeRTOS — C6 is single-core
CONFIG_FREERTOS_HZ=1000
CONFIG_FREERTOS_UNICORE=y

# BLE — NimBLE observer only (phase 2+)
CONFIG_BT_ENABLED=y
CONFIG_BT_NIMBLE_ENABLED=y
CONFIG_BT_NIMBLE_ROLE_OBSERVER=y
CONFIG_BT_NIMBLE_ROLE_CENTRAL=n
CONFIG_BT_NIMBLE_ROLE_PERIPHERAL=n
CONFIG_BT_NIMBLE_ROLE_BROADCASTER=n
CONFIG_BT_NIMBLE_SECURITY_ENABLE=n
CONFIG_BT_NIMBLE_MAX_CONNECTIONS=1

# Watchdog
CONFIG_ESP_TASK_WDT_TIMEOUT_S=15
```
