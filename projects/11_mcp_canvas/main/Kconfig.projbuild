## projects/11_mcp_canvas/main/Kconfig.projbuild
```kconfig
menu "MCP Canvas Configuration"

    config CANVAS_WIFI_SSID
        string "WiFi SSID"
        default "YOUR_SSID_HERE"
        help
            WiFi network name for MCP server.

    config CANVAS_WIFI_PASSWORD
        string "WiFi Password"
        default "YOUR_PASSWORD_HERE"
        help
            WiFi password.

endmenu
```

## projects/11_mcp_canvas/sdkconfig.defaults.template
```kconfig
CONFIG_IDF_TARGET="esp32c6"

# Flash / Partition
CONFIG_ESPTOOLPY_FLASHSIZE_16MB=y
CONFIG_PARTITION_TABLE_CUSTOM=y
CONFIG_PARTITION_TABLE_CUSTOM_FILENAME="partitions.csv"

# Compiler — optimize for performance (display rendering)
CONFIG_COMPILER_OPTIMIZATION_PERF=y

# LVGL fonts
CONFIG_LV_FONT_MONTSERRAT_14=y
CONFIG_LV_FONT_MONTSERRAT_20=y

# LVGL memory — 128KB for widget-based drawing (up to 128 objects)
CONFIG_LV_MEM_SIZE_KILOBYTES=128

# LVGL color — SH8601 expects swapped bytes over QSPI
CONFIG_LV_COLOR_16_SWAP=y

# Disable BT — save ~50KB flash + ~30KB RAM
CONFIG_BT_ENABLED=n

# FreeRTOS
CONFIG_FREERTOS_HZ=1000
CONFIG_FREERTOS_UNICORE=y

# HTTP server — large enough for MCP JSON bodies
CONFIG_HTTPD_MAX_URI_LEN=512
CONFIG_HTTPD_MAX_REQ_HDR_LEN=512

# Watchdog — JPEG encode + snapshot can take 200-500ms
CONFIG_ESP_TASK_WDT_TIMEOUT_S=15

# Wi-Fi credentials — copy to sdkconfig.defaults and fill in
CONFIG_CANVAS_WIFI_SSID="YOUR_SSID_HERE"
CONFIG_CANVAS_WIFI_PASSWORD="YOUR_PASSWORD_HERE"
```

## projects/12_baby_cry_dsp/main/Kconfig.projbuild
```kconfig
menu "Baby Cry Monitor Configuration"

    config CANVAS_WIFI_SSID
        string "WiFi SSID"
        default "your_ssid"
        help
            WiFi network name to connect to.

    config CANVAS_WIFI_PASSWORD
        string "WiFi Password"
        default "your_password"
        help
            WiFi network password.

    config LOG_INTERVAL_SEC
        int "Periodic metrics log interval (seconds)"
        default 300
        range 10 3600
        help
            Interval for logging sound metrics to SD card (RMS, cry ratio, noise floor, state).
            Set to 300 for every 5 minutes. Min 10s, max 1 hour.

endmenu
```

## projects/13_baby_cry_vad/main/Kconfig.projbuild
```kconfig
menu "Baby Cry VAD Configuration"

    config BABY_CRY_WIFI_SSID
        string "WiFi SSID"
        default "YOUR_SSID_HERE"
        help
            WiFi network name for status reporting.

    config BABY_CRY_WIFI_PASSWORD
        string "WiFi Password"
        default "YOUR_PASSWORD_HERE"
        help
            WiFi network password.

endmenu
```

## projects/15_nursery_rhymes/main/Kconfig.projbuild
```kconfig
menu "Nursery Rhyme Song Selection"

    config SONG_INCLUDE_ALL
        bool "Include all songs (default)"
        default y
        help
            When enabled, all 20 songs are included. Disable to select individual songs.

    config SONG_TWINKLE
        bool "1. Twinkle Twinkle Little Star"
        default y
        depends on !SONG_INCLUDE_ALL

    config SONG_MARY
        bool "2. Mary Had a Little Lamb"
        default y
        depends on !SONG_INCLUDE_ALL

    config SONG_BAA_BAA
        bool "3. Baa Baa Black Sheep"
        default y
        depends on !SONG_INCLUDE_ALL

    config SONG_LONDON_BRIDGE
        bool "4. London Bridge Is Falling Down"
        default y
        depends on !SONG_INCLUDE_ALL

    config SONG_ROW_BOAT
        bool "5. Row Row Row Your Boat"
        default y
        depends on !SONG_INCLUDE_ALL

    config SONG_JACK_JILL
        bool "6. Jack and Jill"
        default y
        depends on !SONG_INCLUDE_ALL

    config SONG_HUMPTY
        bool "7. Humpty Dumpty"
        default y
        depends on !SONG_INCLUDE_ALL

    config SONG_ITSY_BITSY
        bool "8. Itsy Bitsy Spider"
        default y
        depends on !SONG_INCLUDE_ALL

    config SONG_OLD_MACDONALD
        bool "9. Old MacDonald Had a Farm"
        default y
        depends on !SONG_INCLUDE_ALL

    config SONG_HICKORY
        bool "10. Hickory Dickory Dock"
        default y
        depends on !SONG_INCLUDE_ALL

    config SONG_THREE_BLIND_MICE
        bool "11. Three Blind Mice"
        default y
        depends on !SONG_INCLUDE_ALL

    config SONG_HOT_CROSS_BUNS
        bool "12. Hot Cross Buns"
        default y
        depends on !SONG_INCLUDE_ALL

    config SONG_FRERE_JACQUES
        bool "13. Frere Jacques"
        default y
        depends on !SONG_INCLUDE_ALL

    config SONG_YANKEE_DOODLE
        bool "14. Yankee Doodle"
        default y
        depends on !SONG_INCLUDE_ALL

    config SONG_POP_WEASEL
        bool "15. Pop Goes the Weasel"
        default y
        depends on !SONG_INCLUDE_ALL

    config SONG_ROCK_A_BYE
        bool "16. Rock-a-Bye Baby"
        default y
        depends on !SONG_INCLUDE_ALL

    config SONG_HUSH_LITTLE_BABY
        bool "17. Hush Little Baby"
        default y
        depends on !SONG_INCLUDE_ALL

    config SONG_WHEELS_BUS
        bool "18. Wheels on the Bus"
        default y
        depends on !SONG_INCLUDE_ALL

    config SONG_HEAD_SHOULDERS
        bool "19. Head Shoulders Knees and Toes"
        default y
        depends on !SONG_INCLUDE_ALL

    config SONG_HAPPY_KNOW_IT
        bool "20. If You're Happy and You Know It"
        default y
        depends on !SONG_INCLUDE_ALL

    config SONG_THIS_OLD_MAN
        bool "21. This Old Man"
        default y
        depends on !SONG_INCLUDE_ALL

    config SONG_FARMER_DELL
        bool "22. The Farmer in the Dell"
        default y
        depends on !SONG_INCLUDE_ALL

    config SONG_BINGO
        bool "23. BINGO"
        default y
        depends on !SONG_INCLUDE_ALL

    config SONG_LITTLE_TEAPOT
        bool "24. I'm a Little Teapot"
        default y
        depends on !SONG_INCLUDE_ALL

    config SONG_ALOUETTE
        bool "25. Alouette"
        default y
        depends on !SONG_INCLUDE_ALL

    config SONG_OH_SUSANNA
        bool "26. Oh! Susanna"
        default y
        depends on !SONG_INCLUDE_ALL

    config SONG_COMING_ROUND
        bool "27. She'll Be Coming Round the Mountain"
        default y
        depends on !SONG_INCLUDE_ALL

    config SONG_MUFFIN_MAN
        bool "28. The Muffin Man"
        default y
        depends on !SONG_INCLUDE_ALL

    config SONG_SIXPENCE
        bool "29. Sing a Song of Sixpence"
        default y
        depends on !SONG_INCLUDE_ALL

    config SONG_CLEMENTINE
        bool "30. Oh My Darling Clementine"
        default y
        depends on !SONG_INCLUDE_ALL

    config SONG_DOWN_STATION
        bool "31. Down by the Station"
        default y
        depends on !SONG_INCLUDE_ALL

    config SONG_FIVE_DUCKS
        bool "32. Five Little Ducks"
        default y
        depends on !SONG_INCLUDE_ALL

    config SONG_BEAR_MOUNTAIN
        bool "33. The Bear Went Over the Mountain"
        default y
        depends on !SONG_INCLUDE_ALL

    config SONG_LAVENDERS_BLUE
        bool "34. Lavender's Blue"
        default y
        depends on !SONG_INCLUDE_ALL

    config SONG_MY_BONNIE
        bool "35. My Bonnie"
        default y
        depends on !SONG_INCLUDE_ALL

    config SONG_POLLY_KETTLE
        bool "36. Polly Put the Kettle On"
        default y
        depends on !SONG_INCLUDE_ALL

    config SONG_BO_PEEP
        bool "37. Little Bo Peep"
        default y
        depends on !SONG_INCLUDE_ALL

    config SONG_HEY_DIDDLE
        bool "38. Hey Diddle Diddle"
        default y
        depends on !SONG_INCLUDE_ALL

    config SONG_SKIP_TO_LOU
        bool "39. Skip to My Lou"
        default y
        depends on !SONG_INCLUDE_ALL

    config SONG_RAILROAD
        bool "40. I've Been Working on the Railroad"
        default y
        depends on !SONG_INCLUDE_ALL

endmenu
```

## projects/15_nursery_rhymes/sdkconfig.defaults
```kconfig
# Target
CONFIG_IDF_TARGET="esp32c6"

# Console — board's USB-C is wired to native USB (GPIO 12/13), not UART0
CONFIG_ESP_CONSOLE_USB_SERIAL_JTAG=y

# Flash
CONFIG_ESPTOOLPY_FLASHSIZE_16MB=y

# Partition table
CONFIG_PARTITION_TABLE_CUSTOM=y
CONFIG_PARTITION_TABLE_CUSTOM_FILENAME="partitions.csv"

# LVGL
CONFIG_LV_MEM_CUSTOM=y
CONFIG_LV_COLOR_16_SWAP=y

# LVGL fonts
CONFIG_LV_FONT_MONTSERRAT_12=y
CONFIG_LV_FONT_MONTSERRAT_16=y
CONFIG_LV_FONT_MONTSERRAT_18=y
CONFIG_LV_FONT_MONTSERRAT_22=y
CONFIG_LV_FONT_MONTSERRAT_28=y
CONFIG_LV_FONT_MONTSERRAT_40=y

# Disable BT to save RAM
CONFIG_BT_ENABLED=n

# FreeRTOS
CONFIG_FREERTOS_HZ=1000
```

## projects/16_bitchat_relay/sdkconfig.defaults.template
```kconfig
CONFIG_IDF_TARGET="esp32c6"

# Flash / Partition
CONFIG_ESPTOOLPY_FLASHSIZE_16MB=y
CONFIG_PARTITION_TABLE_CUSTOM=y
CONFIG_PARTITION_TABLE_CUSTOM_FILENAME="partitions.csv"

# Compiler — optimize for performance
CONFIG_COMPILER_OPTIMIZATION_PERF=y

# LVGL fonts
CONFIG_LV_FONT_MONTSERRAT_14=y
CONFIG_LV_FONT_MONTSERRAT_20=y
CONFIG_LV_FONT_MONTSERRAT_28=y

# LVGL memory — 24KB for simple dashboard
CONFIG_LV_MEM_SIZE_KILOBYTES=24

# LVGL color — SH8601 expects swapped bytes over QSPI
CONFIG_LV_COLOR_16_SWAP=y

# BLE — NimBLE
CONFIG_BT_ENABLED=y
CONFIG_BT_NIMBLE_ENABLED=y
CONFIG_BT_NIMBLE_MAX_CONNECTIONS=9
CONFIG_BT_NIMBLE_ROLE_CENTRAL=y
CONFIG_BT_NIMBLE_ROLE_PERIPHERAL=y
CONFIG_BT_NIMBLE_ROLE_OBSERVER=y
CONFIG_BT_NIMBLE_ROLE_BROADCASTER=y

# No Wi-Fi — save ~55KB RAM
CONFIG_ESP_WIFI_ENABLED=n

# FreeRTOS
CONFIG_FREERTOS_HZ=1000
CONFIG_FREERTOS_UNICORE=y

# Watchdog
CONFIG_ESP_TASK_WDT_TIMEOUT_S=15
```

## projects/17_pixelpet/main/Kconfig.projbuild
```kconfig
menu "PixelPet"

    config PIXELPET_TIME_SCALE
        int "Game-time scale factor"
        range 1 3600
        default 120
        help
            Multiplier between real seconds and game seconds. With the
            default of 120, one real minute equals two game hours, so:
              EGG → BABY    in ~15 real-min
              BABY → CHILD  in   3 real-min after that
              TEEN → ADULT  in  36 real-min after that
              ADULT → SENIOR in 84 real-min after that
            The full lifecycle is ~2.5 real-hours — long enough to feel
            like a pet, short enough for an evening playtest. Set to 1
            for true real-time play (one game-day = one real-day) or to
            360 for fast iteration (lifecycle in ~30 real-min).

endmenu
```

## projects/17_pixelpet/sdkconfig.defaults.template
```kconfig
CONFIG_IDF_TARGET="esp32c6"
CONFIG_ESPTOOLPY_FLASHSIZE_16MB=y
CONFIG_PARTITION_TABLE_CUSTOM=y
CONFIG_PARTITION_TABLE_CUSTOM_FILENAME="partitions.csv"
CONFIG_COMPILER_OPTIMIZATION_PERF=y

# LVGL
CONFIG_LV_FONT_MONTSERRAT_14=y
CONFIG_LV_FONT_MONTSERRAT_20=y
CONFIG_LV_FONT_MONTSERRAT_28=y
CONFIG_LV_MEM_SIZE_KILOBYTES=48
CONFIG_LV_COLOR_16_SWAP=y

# FreeRTOS
CONFIG_FREERTOS_HZ=1000
CONFIG_FREERTOS_UNICORE=y

# No Bluetooth (save RAM)
CONFIG_BT_ENABLED=n

# NVS
CONFIG_NVS_ENCRYPTION=n

# Watchdog
CONFIG_ESP_TASK_WDT_TIMEOUT_S=15

# Route stdio over the C6's native USB Serial JTAG so idf.py monitor
# (and any plain serial reader) sees app log output. The board's USB-C
# connector goes straight to the C6's USB pins (GPIO 12/13), not to UART0.
CONFIG_ESP_CONSOLE_USB_SERIAL_JTAG=y

# Game-time scale. 120 = 1 real-min per 2 game-hours; full lifecycle ≈ 2.5 hrs.
# Bump to 360 for fast iteration; drop to 1 for true real-time pet aging.
CONFIG_PIXELPET_TIME_SCALE=120
```
